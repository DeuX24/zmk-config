// This file was generated from a template. Edit it to match your keyboard.
// See https://zmk.dev/docs/development/hardware-integration/new-shield for more
// instructions.

#include "btn_macro-layouts.dtsi"

/ {
    chosen {
        zmk,kscan = &kscan;
        zmk,physical-layout = &default_layout;
    };

    kscan: kscan {
        compatible = "zmk,kscan-gpio-direct";
        wakeup-source;
        input-gpios
            = <&pro_micro 1 (GPIO_ACTIVE_LOW | GPIO_PULL_UP)>
            ;
    };
};
